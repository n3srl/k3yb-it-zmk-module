## Kconfig
```kconfig
config K3YB_KSCAN_GPIO_DEMUX
    bool "k3yb demux kscan driver with active discharge and settle time"
    default y
    depends on DT_HAS_K3YB_KSCAN_GPIO_DEMUX_ENABLED
    select GPIO

config K3YB_LED_MUX
    bool "k3yb status LEDs via CD4052 mux"
    default y
    depends on DT_HAS_K3YB_LED_MUX_ENABLED
    select GPIO

config K3YB_BEHAVIOR_REPEAT
    bool "k3yb auto-repeat wrapper behavior"
    default y
    depends on DT_HAS_K3YB_BEHAVIOR_REPEAT_ENABLED

config K3YB_BEHAVIOR_LED
    bool "k3yb LED control behavior (backlight / flame toggles)"
    default y
    depends on DT_HAS_K3YB_BEHAVIOR_LED_ENABLED
    depends on K3YB_LED_MUX

config K3YB_BACKLIGHT_MAX
    int "Maximum backlight PWM level (0-255)"
    depends on K3YB_LED_MUX
    range 0 255
    default 64
    help
      Hard cap on the per-key backlight duty, battery-oriented.  The
      brightness step table lives in src/led_mux.c (bl_levels[]); steps
      above this cap are clamped at output time.

config K3YB_LED_BLINK_INDEX
    int "Status indicator used for blink feedback (0-3 = Y0-Y3)"
    depends on K3YB_LED_MUX
    range 0 3
    default 3
    help
      Indicator taken over by the recorder blink (Y3 = the layer LED).
      While a blink is active it overrides that LED's normal state.

config K3YB_LED_BLINK_PERIOD_MS
    int "Slow blink period in ms (50% duty)"
    depends on K3YB_LED_MUX
    range 200 10000
    default 1000
    help
      Blink shown while the recorder is recording.  Sampled by the 40 ms
      LED refresh, so the phase resolution is 40 ms.

config K3YB_RECORDER
    bool "k3yb offline keystroke recorder (internal flash)"
    default y
    depends on $(dt_nodelabel_enabled,recorder_partition)
    depends on K3YB_LED_MUX
    select FLASH
    select FLASH_MAP
    help
      Records key presses to the dedicated recorder_partition (see
      k3yb_it.dtsi) and replays them via HID.  Controlled by the
      &ledctl K3YB_LED_REC_* actions.  The buffer holds typed keys in
      clear text until CLEAR.

if K3YB_RECORDER

config K3YB_RECORDER_PLAYBACK_DELAY_MS
    int "Playback delay between HID steps in ms"
    range 1 1000
    default 12
    help
      Fixed delay after every press, release and modifier change during
      playback (~2 steps per key).  Raise it if the host drops keys.

config K3YB_RECORDER_RESUME
    bool "Resume recording after reset / deep-sleep wake"
    default y
    depends on SETTINGS
    help
      Persists the REC on/off flag (one settings entry, not the buffer),
      so ZMK's idle deep sleep does not end a recording session.

endif # K3YB_RECORDER



config K3YB_STATUS_ICONS
    bool "Status screen uses LVGL symbol icons instead of text markers"
    default n
    help
      Replaces the USB/BT/CH text markers and the battery percentage with
      the built-in LV_SYMBOL_* glyphs, all on the top row (battery on the
      right).  Kept behind an option: glyph rendering crashed the display
      thread before the stack/layout fixes, so text-only stays the default.

config K3YB_SSD1327
    bool "k3yb SSD1327 grayscale OLED driver (mono over I2C)"
    default y
    depends on DT_HAS_K3YB_SSD1327_ENABLED
    depends on DISPLAY
    select I2C

config K3YB_SH1107
    bool "k3yb SH1107 mono OLED driver (I2C)"
    default y
    depends on DT_HAS_K3YB_SH1107_ENABLED
    depends on DISPLAY
    select I2C

if K3YB_SH1107

config K3YB_SH1107_FB_SIZE
    int
    default 2048
    help
      Shadow framebuffer size in bytes (width/8 * height).

endif # K3YB_SH1107

if K3YB_SSD1327

config K3YB_SSD1327_FB_SIZE
    int
    default 8192
    help
      Shadow framebuffer size in bytes (width/2 * height).

config K3YB_SSD1327_TEST_PATTERN
    bool "Draw a calibration test pattern at init"
    default n
    help
      Draws a geometric fingerprint (top edge, left edge, corner blocks)
      at driver init to calibrate the panel remap from a photo.

endif # K3YB_SSD1327
```

## dts/bindings/behaviors/k3yb,behavior-led.yaml
```yaml
# Copyright (c) 2026 k3yb.it
# SPDX-License-Identifier: MIT

description: |
  Local LED-control behavior (&ledctl <action>): backlight on/off,
  brightness step up/down, backlight flame, status-indicator flame.
  Drives the k3yb LED controller directly - no HID events are sent.
  Actions in include/dt-bindings/k3yb/led.h.

compatible: "k3yb,behavior-led"

include: one_param.yaml
```

## dts/bindings/behaviors/k3yb,behavior-repeat.yaml
```yaml
# Copyright (c) 2026 k3yb.it
# SPDX-License-Identifier: MIT

description: |
  Auto-repeats the wrapped behavior while the key is held (initial
  delay, then repeat rate), like OS key repeat but firmware side.
  Needed for macro-based keys (e.g. accent macros) that the host
  cannot auto-repeat.

compatible: "k3yb,behavior-repeat"

include: zero_param.yaml

properties:
  bindings:
    type: phandles
    required: true
  delay-ms:
    type: int
    default: 400
  rate-ms:
    type: int
    default: 250
    description: |
      Repeat period.  Must exceed the wrapped macro's run time (the accent
      macros take ~210 ms with ZMK's default wait/tap times): the wrapped
      binding is released only after the macro finishes, and a fire that
      overlaps the previous one is skipped.
```

## dts/bindings/kscan/k3yb,kscan-gpio-demux.yaml
```yaml
# Copyright (c) 2020, The ZMK Contributors
# SPDX-License-Identifier: MIT

description: |
  GPIO keyboard demux controller with active input discharge and
  configurable settle time (fork of zmk,kscan-gpio-demux).

compatible: "k3yb,kscan-gpio-demux"

include: kscan.yaml

properties:
  input-gpios:
    type: phandle-array
    required: true
  output-gpios:
    type: phandle-array
    required: true
  direct-gpios:
    type: phandle-array
    required: true
    description: Directly driven column GPIOs, scanned sequentially after the demux columns
  debounce-period:
    type: int
    default: 5
    description: Stable milliseconds required for both press and release; zero disables debounce
  settle-time-us:
    type: int
    default: 10
    description: Microseconds to wait before each of two row samples after an address change
  active-discharge:
    type: boolean
    description: |
      Actively drive rows low after each column change. Kills residual-charge
      ghosting, but while a key is held it briefly shorts the driven-high
      column into the driven-low row pin, stressing both beyond nRF specs.
      Leave off unless ghosting is proven on healthy hardware.
  polling-interval-msec:
    type: int
    default: 25
```
