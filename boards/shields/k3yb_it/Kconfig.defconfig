## boards/shields/k3yb_it/Kconfig.defconfig
```kconfig
if SHIELD_K3YB_IT || SHIELD_K3YB_IT_OLED32 || SHIELD_K3YB_IT_OLED128

config ZMK_KEYBOARD_NAME
    default "k3yb.it"

if ZMK_DISPLAY

config I2C
    default y

endif # ZMK_DISPLAY

# LVGL settings for the monochrome-driven OLED variants
if LVGL

config LV_Z_VDB_SIZE
    default 64

config LV_DPI_DEF
    default 148

config LV_Z_BITS_PER_PIXEL
    default 1

choice LV_COLOR_DEPTH
    default LV_COLOR_DEPTH_1
endchoice

endif # LVGL

endif # any k3yb_it variant

# SSD1306 in-tree driver for the 128x32 variant
if SHIELD_K3YB_IT_OLED32 && ZMK_DISPLAY

config SSD1306
    default y

endif
```

## boards/shields/k3yb_it/Kconfig.shield
```kconfig
config SHIELD_K3YB_IT
    def_bool $(shields_list_contains,k3yb_it)

config SHIELD_K3YB_IT_OLED32
    def_bool $(shields_list_contains,k3yb_it_oled32)

config SHIELD_K3YB_IT_OLED128
    def_bool $(shields_list_contains,k3yb_it_oled128)
```

## dts/bindings/display/k3yb,sh1107.yaml
```yaml
# Copyright (c) 2026 k3yb.it
# SPDX-License-Identifier: MIT

description: SH1107 monochrome OLED over I2C (custom k3yb driver)

compatible: "k3yb,sh1107"

include: i2c-device.yaml

properties:
  width:
    type: int
    default: 128
  height:
    type: int
    default: 128
  segment-remap:
    type: boolean
    description: Mirror horizontally (0xA1)
  com-invdir:
    type: boolean
    description: Mirror vertically (0xC8)
  display-offset:
    type: int
    default: 0
  internal-dcdc:
    type: boolean
    description: Use the internal charge pump (module has no external boost)
```

## dts/bindings/display/k3yb,ssd1327.yaml
```yaml
# Copyright (c) 2026 k3yb.it
# SPDX-License-Identifier: MIT

description: SSD1327 grayscale OLED driven as monochrome over I2C (custom k3yb driver)

compatible: "k3yb,ssd1327"

include: i2c-device.yaml

properties:
  width:
    type: int
    default: 128
    description: Horizontal resolution in pixels
  height:
    type: int
    default: 128
    description: Vertical resolution in pixels
  remap-value:
    type: int
    default: 0x51
    description: Value for the 0xA0 segment remap register (orientation/mirroring)
```

## dts/bindings/gpio/k3yb,led-mux.yaml
```yaml
# Copyright (c) 2026 k3yb.it
# SPDX-License-Identifier: MIT

description: |
  Four status LEDs multiplexed through a CD4052 dual 4:1 analog mux.
  The driver cycles the A/B select lines and gates the inhibit pin,
  time-multiplexing the LEDs at ~125 Hz.
  Y0 = Num Lock, Y1 = Caps Lock, Y2 = Scroll Lock, Y3 = accent layer.

compatible: "k3yb,led-mux"

properties:
  a-gpios:
    type: phandle-array
    required: true
    description: Select bit A (LSB)
  b-gpios:
    type: phandle-array
    required: true
    description: Select bit B (MSB)
  inh-gpios:
    type: phandle-array
    required: true
    description: Inhibit pin (drive to inactive level to light the selected LED)
```
