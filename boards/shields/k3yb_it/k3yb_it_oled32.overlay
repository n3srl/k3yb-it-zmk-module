/* k3yb.it with SSD1306 128x32 OLED (0.91", 4-pin I2C) */
#include "k3yb_it.dtsi"

/ {
    chosen {
        zephyr,display = &oled;
    };
};

&i2c0 {
    oled: ssd1306@3c {
        compatible = "solomon,ssd1306fb";
        reg = <0x3c>;
        width = <128>;
        height = <32>;
        segment-offset = <0>;
        page-offset = <0>;
        display-offset = <0>;
        multiplex-ratio = <31>;
        segment-remap;
        com-invdir;
        com-sequential;
        prechargep = <0x22>;
    };
};
